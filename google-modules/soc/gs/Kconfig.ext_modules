## google-modules/soc/gs/Kconfig.ext_modules
```kconfig
# SPDX-License-Identifier: GPL-2.0

source "$(KCONFIG_EXT_MODULES_PREFIX)private/google-modules/bms/misc/Kconfig"
source "$(KCONFIG_EXT_MODULES_PREFIX)private/google-modules/display/common/Kconfig"
source "$(KCONFIG_EXT_MODULES_PREFIX)private/google-modules/display/samsung/Kconfig"
source "$(KCONFIG_EXT_MODULES_PREFIX)private/google-modules/display/samsung/panel/Kconfig"
source "$(KCONFIG_EXT_MODULES_PREFIX)private/google-modules/fingerprint/goodix/fps_touch_handler/Kconfig"
source "$(KCONFIG_EXT_MODULES_PREFIX)private/google-modules/power/mitigation/Kconfig"
source "$(KCONFIG_EXT_MODULES_PREFIX)private/google-modules/power/reset/Kconfig"
source "$(KCONFIG_EXT_MODULES_PREFIX)private/google-modules/touch/common/Kconfig"
source "$(KCONFIG_EXT_MODULES_PREFIX)private/google-modules/trusty/drivers/trusty/Kconfig"
source "$(KCONFIG_EXT_MODULES_PREFIX)private/google-modules/video/gchips/Kconfig"
```
