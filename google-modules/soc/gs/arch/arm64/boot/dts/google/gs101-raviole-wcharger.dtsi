// SPDX-License-Identifier: GPL-2.0-only
/*
 * Wireless Charger device tree entries.
 *
 * Copyright 2020 Google Inc.
 */

#include <arm64/exynos/exynos-pinctrl.h>
#include <dt-bindings/interrupt-controller/irq.h>

#include "gs101-whitefin2-wcharger.dtsi"

&hsi2c_8 {
	p9412@3c {
		/* RTX */
		idt,has_rtx = <1>;
		idt,extben-gpio = <&gpp1 3 GPIO_ACTIVE_HIGH>;
		/* WLCDC */
		idt,dc_switch-gpio = <&s2mpg10_gpio 0 GPIO_ACTIVE_HIGH>;
		idt,max_vout_mv = <19500>;
		idt,has_wlc_dc = <1>;
		/* Enable */
		idt,wlc_en-gpio = <&s2mpg10_gpio 2 GPIO_ACTIVE_HIGH>;
		idt,qi_vbus_en-gpio = <&s2mpg10_gpio 2 GPIO_ACTIVE_HIGH>;
		idt,qien-gpio = <&gpp27 3 GPIO_ACTIVE_LOW>;

		/* CSP */
		idt,fuel-gauge = <&max77759_fg>;
		/* Defender */
		google,power_mitigate_threshold = <90>;
		google,has-sw-ramp;

		/* TXID: Phone type */
		idt,tx_id_phone_type = /bits/ 8 <2>;

		p9xxx_gpio: p9xxx_gpio {
			gpio-controller;
			#gpio-cells = <2>;
			ngpios = <16>;
		};

	};
};
